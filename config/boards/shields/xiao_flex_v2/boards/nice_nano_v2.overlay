/* Board-specific pin remap: applied on top of xiao_flex_v2.dtsi/left/right
 * overlays whenever this shield is built for board=nice_nano_v2. */

&kscan0 {
    /* rows on pro_micro D0-D4 (nice!nano v2: P0.08, P0.06, P0.17, P0.20, P0.22) */
    row-gpios
        = <&pro_micro 0 (GPIO_ACTIVE_HIGH | GPIO_PULL_DOWN)>
        , <&pro_micro 1 (GPIO_ACTIVE_HIGH | GPIO_PULL_DOWN)>
        , <&pro_micro 2 (GPIO_ACTIVE_HIGH | GPIO_PULL_DOWN)>
        , <&pro_micro 3 (GPIO_ACTIVE_HIGH | GPIO_PULL_DOWN)>
        , <&pro_micro 4 (GPIO_ACTIVE_HIGH | GPIO_PULL_DOWN)>
        ;
    /* cols on pro_micro D5-D10 (nice!nano v2: P0.24, P1.00, P0.11, P1.04, P1.06, P0.09) */
    col-gpios
        = <&pro_micro 5 GPIO_ACTIVE_HIGH>
        , <&pro_micro 6 GPIO_ACTIVE_HIGH>
        , <&pro_micro 7 GPIO_ACTIVE_HIGH>
        , <&pro_micro 8 GPIO_ACTIVE_HIGH>
        , <&pro_micro 9 GPIO_ACTIVE_HIGH>
        , <&pro_micro 10 GPIO_ACTIVE_HIGH>
        ;
};

&right_encoder {
    /* pro_micro D18/D19 (nice!nano v2: P1.15, P0.02) - free of matrix/SPI pins */
    a-gpios = <&pro_micro 18 (GPIO_ACTIVE_HIGH | GPIO_PULL_UP)>;
    b-gpios = <&pro_micro 19 (GPIO_ACTIVE_HIGH | GPIO_PULL_UP)>;
};
